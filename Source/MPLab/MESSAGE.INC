;**********************************************************************
MES_CLOSE_SHUTTER:
		CALL	CLEAR_LCD
		MOVLW	B'11000010'	;-\SET POSITION TO
		CALL	LCD_IR		;-/2 LINE AND 2 SEGMENT
		MOVLW	0X43		;-\OUT CHAR
		CALL	LCD_DR		;-/C
		MOVLW	0X4C		;-\OUT CHAR
		CALL	LCD_DR		;-/L
		MOVLW	0X4F		;-\OUT CHAR
		CALL	LCD_DR		;-/O
		MOVLW	0X53		;-\OUT CHAR
		CALL	LCD_DR		;-/S
		MOVLW	0X45		;-\OUT CHAR
		CALL	LCD_DR		;-/E
		MOVLW	0X20		;-\OUT CHAR
		CALL	LCD_DR		;-/''
		MOVLW	0X54		;-\OUT CHAR
		CALL	LCD_DR		;-/T
		MOVLW	0X48		;-\OUT CHAR
		CALL	LCD_DR		;-/H
		MOVLW	0X45		;-\OUT CHAR
		CALL	LCD_DR		;-/E
		MOVLW	0X20		;-\OUT CHAR
		CALL	LCD_DR		;-/''
		MOVLW	0X53		;-\OUT CHAR
		CALL	LCD_DR		;-/S
		MOVLW	0X48		;-\OUT CHAR
		CALL	LCD_DR		;-/H
		MOVLW	0X55		;-\OUT CHAR
		CALL	LCD_DR		;-/U
		MOVLW	0X54		;-\OUT CHAR
		CALL	LCD_DR		;-/T
		MOVLW	0X54		;-\OUT CHAR
		CALL	LCD_DR		;-/T
		MOVLW	0X45		;-\OUT CHAR
		CALL	LCD_DR		;-/E
		MOVLW	0X52		;-\OUT CHAR
		CALL	LCD_DR		;-/R
		GOTO	OUT_PLEASE
;**********************************************************************
MES_OPEN_SHUTTER:
		CALL	CLEAR_LCD
		MOVLW	B'11000010'	;-\SET POSITION TO
		CALL	LCD_IR		;-/2 LINE AND 2 SEGMENT
		MOVLW	0X4F		;-\OUT CHAR
		CALL	LCD_DR		;-/O
		MOVLW	0X50		;-\OUT CHAR
		CALL	LCD_DR		;-/P
		MOVLW	0X45		;-\OUT CHAR
		CALL	LCD_DR		;-/E
		MOVLW	0X4E		;-\OUT CHAR
		CALL	LCD_DR		;-/N
		MOVLW	0X20		;-\OUT CHAR
		CALL	LCD_DR		;-/''
		MOVLW	0X54		;-\OUT CHAR
		CALL	LCD_DR		;-/T
		MOVLW	0X48		;-\OUT CHAR
		CALL	LCD_DR		;-/H
		MOVLW	0X45		;-\OUT CHAR
		CALL	LCD_DR		;-/E
		MOVLW	0X20		;-\OUT CHAR
		CALL	LCD_DR		;-/''
		MOVLW	0X53		;-\OUT CHAR
		CALL	LCD_DR		;-/S
		MOVLW	0X48		;-\OUT CHAR
		CALL	LCD_DR		;-/H
		MOVLW	0X55		;-\OUT CHAR
		CALL	LCD_DR		;-/U
		MOVLW	0X54		;-\OUT CHAR
		CALL	LCD_DR		;-/T
		MOVLW	0X54		;-\OUT CHAR
		CALL	LCD_DR		;-/T
		MOVLW	0X45		;-\OUT CHAR
		CALL	LCD_DR		;-/E
		MOVLW	0X52		;-\OUT CHAR
		CALL	LCD_DR		;-/R
		GOTO	OUT_PLEASE
;**********************************************************************
MES_CHANGE_FD:
		CALL	CLEAR_LCD
		MOVLW	B'11000000'	;-\SET POSITION TO
		CALL	LCD_IR		;-/2 LINE AND 0 SEGMENT
		MOVLW	0X43		;-\OUT CHAR
		CALL	LCD_DR		;-/C
		MOVLW	0X48		;-\OUT CHAR
		CALL	LCD_DR		;-/H
		MOVLW	0X41		;-\OUT CHAR
		CALL	LCD_DR		;-/A
		MOVLW	0X4E		;-\OUT CHAR
		CALL	LCD_DR		;-/N
		MOVLW	0X47		;-\OUT CHAR
		CALL	LCD_DR		;-/G
		MOVLW	0X45		;-\OUT CHAR
		CALL	LCD_DR		;-/E
		MOVLW	0X20		;-\OUT CHAR
		CALL	LCD_DR		;-/''
		MOVLW	0X50		;-\OUT CHAR
		CALL	LCD_DR		;-/P
		MOVLW	0X48		;-\OUT CHAR
		CALL	LCD_DR		;-/H
		MOVLW	0X4F		;-\OUT CHAR
		CALL	LCD_DR		;-/O
		MOVLW	0X54		;-\OUT CHAR
		CALL	LCD_DR		;-/T
		MOVLW	0X4F		;-\OUT CHAR
		CALL	LCD_DR		;-/O
		MOVLW	0X44		;-\OUT CHAR
		CALL	LCD_DR		;-/D
		MOVLW	0X45		;-\OUT CHAR
		CALL	LCD_DR		;-/E
		MOVLW	0X54		;-\OUT CHAR
		CALL	LCD_DR		;-/T
		MOVLW	0X45		;-\OUT CHAR
		CALL	LCD_DR		;-/E
		MOVLW	0X43		;-\OUT CHAR
		CALL	LCD_DR		;-/C
		MOVLW	0X54		;-\OUT CHAR
		CALL	LCD_DR		;-/T
		MOVLW	0X4F		;-\OUT CHAR
		CALL	LCD_DR		;-/O
		MOVLW	0X52		;-\OUT CHAR
		CALL	LCD_DR		;-/R
		GOTO	OUT_PLEASE
;**********************************************************************
MES_CHANGE_LP:
		CALL	CLEAR_LCD
		MOVLW	B'11000001'	;-\SET POSITION TO
		CALL	LCD_IR		;-/2 LINE AND 1 SEGMENT
		MOVLW	0X43		;-\OUT CHAR
		CALL	LCD_DR		;-/C
		MOVLW	0X48		;-\OUT CHAR
		CALL	LCD_DR		;-/H
		MOVLW	0X41		;-\OUT CHAR
		CALL	LCD_DR		;-/A
		MOVLW	0X4E		;-\OUT CHAR
		CALL	LCD_DR		;-/N
		MOVLW	0X47		;-\OUT CHAR
		CALL	LCD_DR		;-/G
		MOVLW	0X45		;-\OUT CHAR
		CALL	LCD_DR		;-/E
		MOVLW	0X20		;-\OUT CHAR
		CALL	LCD_DR		;-/''
		MOVLW	0X53		;-\OUT CHAR
		CALL	LCD_DR		;-/S
		MOVLW	0X4F		;-\OUT CHAR
		CALL	LCD_DR		;-/O
		MOVLW	0X55		;-\OUT CHAR
		CALL	LCD_DR		;-/U
		MOVLW	0X52		;-\OUT CHAR
		CALL	LCD_DR		;-/R
		MOVLW	0X53		;-\OUT CHAR
		CALL	LCD_DR		;-/S
		MOVLW	0X20		;-\OUT CHAR
		CALL	LCD_DR		;-/''
		MOVLW	0X4C		;-\OUT CHAR
		CALL	LCD_DR		;-/L
		MOVLW	0X49		;-\OUT CHAR
		CALL	LCD_DR		;-/I
		MOVLW	0X47		;-\OUT CHAR
		CALL	LCD_DR		;-/G
		MOVLW	0X48		;-\OUT CHAR
		CALL	LCD_DR		;-/H
		MOVLW	0X54		;-\OUT CHAR
		CALL	LCD_DR		;-/T
		GOTO	OUT_PLEASE
;**********************************************************************
MES_SET_SAMPLE:
		CALL	CLEAR_LCD
		MOVLW	B'11000101'	;-\SET POSITION TO
		CALL	LCD_IR		;-/2 LINE AND 5 SEGMENT
		MOVLW	0X53		;-\OUT CHAR
		CALL	LCD_DR		;-/S
		MOVLW	0X45		;-\OUT CHAR
		CALL	LCD_DR		;-/E
		MOVLW	0X54		;-\OUT CHAR
		CALL	LCD_DR		;-/T
		MOVLW	0X20		;-\OUT CHAR
		CALL	LCD_DR		;-/''
		MOVLW	0X53		;-\OUT CHAR
		CALL	LCD_DR		;-/S
		MOVLW	0X41		;-\OUT CHAR
		CALL	LCD_DR		;-/A
		MOVLW	0X4D		;-\OUT CHAR
		CALL	LCD_DR		;-/M
		MOVLW	0X50		;-\OUT CHAR
		CALL	LCD_DR		;-/P
		MOVLW	0X4C		;-\OUT CHAR
		CALL	LCD_DR		;-/L
		MOVLW	0X45		;-\OUT CHAR
		CALL	LCD_DR		;-/E
		GOTO	OUT_PLEASE
;**********************************************************************
MES_SET_ZERO:
		CALL	CLEAR_LCD
		MOVLW	B'11000011'	;-\SET POSITION TO
		CALL	LCD_IR		;-/2 LINE AND 3 SEGMENT
		MOVLW	0X53		;-\OUT CHAR
		CALL	LCD_DR		;-/S
		MOVLW	0X45		;-\OUT CHAR
		CALL	LCD_DR		;-/E
		MOVLW	0X54		;-\OUT CHAR
		CALL	LCD_DR		;-/T
		MOVLW	0X20		;-\OUT CHAR
		CALL	LCD_DR		;-/''
		MOVLW	0X5A		;-\OUT CHAR
		CALL	LCD_DR		;-/Z
		MOVLW	0X45		;-\OUT CHAR
		CALL	LCD_DR		;-/E
		MOVLW	0X52		;-\OUT CHAR
		CALL	LCD_DR		;-/R
		MOVLW	0X4F		;-\OUT CHAR
		CALL	LCD_DR		;-/O
		MOVLW	0X20		;-\OUT CHAR
		CALL	LCD_DR		;-/''
		MOVLW	0X53		;-\OUT CHAR
		CALL	LCD_DR		;-/S
		MOVLW	0X41		;-\OUT CHAR
		CALL	LCD_DR		;-/A
		MOVLW	0X4D		;-\OUT CHAR
		CALL	LCD_DR		;-/M
		MOVLW	0X50		;-\OUT CHAR
		CALL	LCD_DR		;-/P
		MOVLW	0X4C		;-\OUT CHAR
		CALL	LCD_DR		;-/L
		MOVLW	0X45		;-\OUT CHAR
		CALL	LCD_DR		;-/E
		GOTO	OUT_PLEASE
;**********************************************************************
MES_ERROR:
		CALL	CLEAR_LCD
		MOVLW	B'10000111'	;-\SET POSITION TO
		CALL	LCD_IR		;-/1 LINE AND 7 SEGMENT
		MOVLW	0X45		;-\OUT CHAR
		CALL	LCD_DR		;-/E
		MOVLW	0X52		;-\OUT CHAR
		CALL	LCD_DR		;-/R
		MOVLW	0X52		;-\OUT CHAR
		CALL	LCD_DR		;-/R
		MOVLW	0X4F		;-\OUT CHAR
		CALL	LCD_DR		;-/O
		MOVLW	0X52		;-\OUT CHAR
		CALL	LCD_DR		;-/R
		RETURN
;**********************************************************************
OUT_PLEASE:
		MOVLW	B'10000111'	;-\SET POSITION TO
		CALL	LCD_IR		;-/1 LINE AND 7 SEGMENT
		MOVLW	0X50		;-\OUT CHAR
		CALL	LCD_DR		;-/P
		MOVLW	0X4C		;-\OUT CHAR
		CALL	LCD_DR		;-/L
		MOVLW	0X45		;-\OUT CHAR
		CALL	LCD_DR		;-/E
		MOVLW	0X41		;-\OUT CHAR
		CALL	LCD_DR		;-/A
		MOVLW	0X53		;-\OUT CHAR
		CALL	LCD_DR		;-/S
		MOVLW	0X45		;-\OUT CHAR
		CALL	LCD_DR		;-/E
		RETURN
;**********************************************************************
