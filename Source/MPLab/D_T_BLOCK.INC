;**********************************************************************
		MOVF	NULL_HIGH,	W	;-\
		SUBWF	MAX_HIGH,	F	; |
		MOVF	NULL_LOW,	W	; |-\ MAX -= NULL
		SUBWF	MAX_LOW,	F	; |-/ MAX == DELTA == DATA
		BTFSS	STATUS,		C	; |
		DECF	MAX_HIGH,	F	;-/
;**********************************
		GOTO	START_D_T_BLOCK
M_SET_NOT_EO:
		BSF		PCLATH,	0X04
		CALL	MES_SET_SAMPLE
		BCF		PCLATH,	0X04
WAIT_SET_SAMPLE:
		BSF		PCLATH,	0X04
		CALL	E0
		BCF		PCLATH,	0X04
		BTFSC	STATUS_HIGH,0X00
		GOTO	WAIT_SET_SAMPLE
START_D_T_BLOCK
		BSF		PCLATH,	0X04
		CALL	E0
		BCF		PCLATH,	0X04
		BTFSC	STATUS_HIGH,0X00
		GOTO	M_SET_NOT_EO
SET_SAMPLE:
		BSF		PCLATH,	0X04
		CALL	E0
		BCF		PCLATH,	0X04
		BTFSC	STATUS_HIGH,0X00
		GOTO	START_HUNDRED_BLOCK		;GO TO START_HUNDRED_BLOCK
		BSF		PCLATH,	0X04
		CALL	E1
		CALL	E2
		CALL	E3
		CALL	SHOW_MODE
		CALL	SHOW_FD_LAMP
		CALL	SHOW_CAR
		CALL	READ_WAVE
		CALL	SHOW_WAVE
		CALL	READ_DATA
		BCF		PCLATH,	0X04
		BTFSC	STATUS_HIGH,0X07
		GOTO	DIM_D
;**********************************//DIM_T
		CLRF	DELIMOE_H		;-\
		MOVF	NULL_HIGH,	W	; |
		SUBWF	ADC_HIGH,	W	; |
		MOVWF	DELIMOE_M		; |
		MOVF	NULL_LOW,	W	; |-\DELIMOE = ADC -= NULL
		SUBWF	ADC_LOW,	W	; |-/
		MOVWF	DELIMOE_L		; |
		BTFSS	STATUS,		C	; |
		DECF	DELIMOE_M,	F	;-/
		CLRF	DELITEL_H		;-\
		MOVF	MAX_HIGH,	W	; |
		MOVWF	DELITEL_M		; |=>DELITEL = MAX == MAX - NULL
		MOVF	MAX_LOW,	W	; |
		MOVWF	DELITEL_L		;-/
		BSF		PCLATH,	0X04
		CALL	DIV_24
		BSF		STATUS_LOW,0X04
		BSF		STATUS_LOW,0X03
		CALL	SHOW_DATA
		BCF		PCLATH,	0X04
		GOTO	SET_SAMPLE
;**********************************
DIM_D:
;**********************************
		MOVF	MAX_HIGH,	W	;-\
		MOVWF	W_H				; |
		MOVF	MAX_LOW,	W	; |
		MOVWF	W_L				; |=> CALCULATE LOGARITHM OF DELTA
		BSF		PCLATH,	0X04	; |
		CALL	LG				; |
		BCF		PCLATH,	0X04	;-/
		MOVF	RES_CEL_LG,	W	;-\
		MOVWF	TMP_CEL_LG		; |
		MOVF	RES_DROB_LG_H,W	; |-\SAVE RESULT THE LOGARITNM
		MOVWF	TMP_DROB_LG_H	; |-/TO TEMTER REGISTERS
		MOVF	RES_DROB_LG_L,W	; |
		MOVWF	TMP_DROB_LG_L	;-/
		MOVF	NULL_HIGH,	W	;-\
		SUBWF	ADC_HIGH,	W	; |
		MOVWF	W_H				; |
		MOVF	NULL_LOW,	W	; |-\W_H,W_L = ADC - NULL
		SUBWF	ADC_LOW,	W	; |-/
		MOVWF	W_L				; |
		BTFSS	STATUS,		C	; |
		DECF	W_H,	F		;-/
		BSF		PCLATH,	0X04	;-\
		CALL	LG				; |=> CALCULATE LOGARITNM OF (DATA  - NULL)
		BCF		PCLATH,	0X04	;-/
ASB:
		MOVF	RES_CEL_LG,	W	;-\
		SUBWF	TMP_CEL_LG,	W	; |
		MOVWF	RES_CEL_LG		; |
		MOVF	RES_DROB_LG_H,W	; |
		SUBWF	TMP_DROB_LG_H,W	; |
		MOVWF	RES_DROB_LG_H	; |-\
		BTFSS	STATUS,	C		; | |=>RES_LG = TMP_LG - RES_LG
		DECF	RES_CEL_LG,	F	; |-/
		MOVF	RES_DROB_LG_L,W	; |
		SUBWF	TMP_DROB_LG_L,W	; |
		MOVWF	RES_DROB_LG_L	; |
		BTFSS	STATUS,	C		; |
		DECF	RES_DROB_LG_H,F	;-/

		BSF		STATUS_LOW,0X04	;-\
		BCF		STATUS_LOW,0X03	; |-\
		BSF		PCLATH,	0X04	; | |=>SHOW RESULT OF THIS CALCULATION
		CALL	SHOW_DATA		; |-/
		BCF		PCLATH,	0X04	; |
		GOTO	SET_SAMPLE		;-/
;**********************************************************************
;RES_CEL_LG		EQU		0X3C	;-\
;RES_DROB_LG_H	EQU		0X3D	; |=> RESULT OF LOGARITHM
;RES_DROB_LG_L	EQU		0X3E	;-/
;TMP_CEL_LG		EQU		0X3F	;-\
;TMP_DROB_LG_H	EQU		0X40	; |=> OF TEMP THE RESULT LOGARITHM
;TMP_DROB_LG_L	EQU		0X41	;-/
