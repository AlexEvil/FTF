;**********************************************************************
		GOTO	START_HUNDRED_BLOCK
M_SET_E0:
		BSF		PCLATH,	0X04
		CALL	MES_SET_ZERO
		BCF		PCLATH,	0X04
WAIT_SET_E0:
		BSF		PCLATH,	0X04
		CALL	E0
		BCF		PCLATH,	0X04
		BTFSS	STATUS_HIGH,0X00
		GOTO	WAIT_SET_E0
		GOTO	START_HUNDRED_BLOCK
M_OPEN:
		BSF		PCLATH,	0X04
		CALL	MES_OPEN_SHUTTER
		BCF		PCLATH,	0X04
WAIT_OPEN:
		BSF		PCLATH,	0X04
		CALL	BLIND
		BCF		PCLATH,	0X04
		BTFSS	STATUS_HIGH,0X04
		GOTO	WAIT_OPEN
START_HUNDRED_BLOCK:
		BSF		PCLATH,	0X04
		CALL	BLIND
		BCF		PCLATH,	0X04
		BTFSS	STATUS_HIGH,0X04
		GOTO	M_OPEN
		BSF		PCLATH,	0X04
		CALL	E0
		BCF		PCLATH,	0X04
		BTFSS	STATUS_HIGH,0X00
		GOTO	M_SET_E0
;**********************************
		BSF		PCLATH,	0X04
		CALL	MODE
		CALL	FD
		CALL	LAMP
		CALL	SHOW_MODE
		CALL	SHOW_FD_LAMP
		CALL	SHOW_CAR
		CALL	READ_WAVE
		CALL	SHOW_WAVE
		CALL	COMPARING_FD_LAMP
		CALL	READ_DATA
		BCF		STATUS_LOW,0X04
		BSF		STATUS_LOW,0X03
		CALL	SHOW_DATA
		CALL	DIM
		BCF		PCLATH,	0X04
		BTFSC	STATUS_LOW,0X06
		GOTO	MAIN
		BTFSS	STATUS_HIGH,0X06
		GOTO	START_HUNDRED_BLOCK
;**********************************
		MOVF	ADC_HIGH,	W
		MOVWF	MAX_HIGH
		MOVF	ADC_LOW,	W
		MOVWF	MAX_LOW
;**********************************************************************
