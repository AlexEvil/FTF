;SETTING PORTA, PORTB, PORTE, PORTD AND INTERRUPT**********************
		BCF		STATUS,	RP1	;-\SET
		BCF		STATUS,	RP0	;-/BANK 0
		CLRF	INTCON		;OFF ALL INTERRUPTION
		CLRF	PORTA		;INIT CATCH OF PORTA
		CLRF	PORTB		;INIT CATCH OF PORTB
		CLRF	PORTE		;INIT CATCH OF PORTE
		MOVLW	0X92
		MOVWF	PORTD		;INIT CATCH OF PORTD
		BSF		STATUS,	RP0	;=>SET BANK 1
		CLRF	PIE1		;OFF LOCAL INTERRUPTION
		CLRF	PIE2		;OFF LOCAL INTERRUPTION
		CLRF	INTCON		;OFF ALL INTERRUPTION
		MOVLW	0X07		;-\AFF CHANEL THE ADC AND
		MOVWF	ADCON1		;-/ON LINE DIGITAL PORT
		MOVLW	0X10		;-\SET RA0,RA1,RA2,RA3 AS DIGITAL OUTPUT
		MOVWF	TRISA		;-/AND RA4 AS DIGITAL INPUT
		CLRF	TRISB		;=> SET PORTB AS DIGITAL OUTPUT
		CLRF	TRISE		;=> SET PORTE AS DIGITAL OUTPUT
		MOVLW	0X09		;=\ SET RD0,RD3 AS DIGITAL INPUT
		MOVWF	TRISD		;=/ AND OTHER LINE AS DIGITAL OUTPUT
		BCF		STATUS,	RP0	;=>SET BANK 0
;**********************************************************************
		BSF		PCLATH,	0X04
		CALL	SETTING_LCD
		BCF		PCLATH,	0X04
;**********************************************************************
