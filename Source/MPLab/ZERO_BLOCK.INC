;**********************************************************************
		GOTO	START_ZERO_BLOCK
M_CLOSE:
		BSF		PCLATH,	0X04
		CALL	MES_CLOSE_SHUTTER
		BCF		PCLATH,	0X04
WAIT_CLOSE:
		BSF		PCLATH,	0X04
		CALL	BLIND
		BCF		PCLATH,	0X04
		BTFSC	STATUS_HIGH,0X04
		GOTO	WAIT_CLOSE
START_ZERO_BLOCK
		BSF		PCLATH,	0X04
		CALL	BLIND
		BCF		PCLATH,	0X04
		BTFSC	STATUS_HIGH,0X04
		GOTO	M_CLOSE
;**********************************
		BSF		PCLATH,	0X04
		CALL	E0
		CALL	E1
		CALL	E2
		CALL	E3
		CALL	MODE
		CALL	FD
		CALL	LAMP
		CALL	SHOW_MODE
		CALL	SHOW_FD_LAMP
		CALL	SHOW_CAR
		CALL	READ_WAVE
		CALL	SHOW_WAVE
		CALL	READ_DATA
		BCF		STATUS_LOW,0X04
		BCF		STATUS_LOW,0X03
		CALL	SHOW_DATA
		CALL	DIM
		BCF		PCLATH,	0X04
		BTFSS	STATUS_HIGH,0X06
		GOTO	START_ZERO_BLOCK
;**********************************
		MOVF	ADC_HIGH,	W
		MOVWF	NULL_HIGH
		MOVF	ADC_LOW,	W
		MOVWF	NULL_LOW
;**********************************************************************
