;**********************************************************************
;WORKING FROM TO ACCUMULATOR
; USES TEMP
LCD_DR:
		BSF		PORTD,	RS
		GOTO	START_LCD
LCD_IR:
		BCF		PORTD,	RS
START_LCD:
		MOVWF	PORTB
		MOVLW	0XFF
		MOVWF	TEMP
		DECFSZ	TEMP,	F
		GOTO	$-0X01
		BCF		PORTD,	E
		MOVLW	0XFF
		MOVWF	TEMP
		DECFSZ	TEMP,	F
		GOTO	$-0X01
		BSF		PORTD,	E
		RETURN
;**********************************************************************
SETTING_LCD:
		MOVLW		0X38	;-\8 DYGITAL BUS
		CALL		LCD_IR	;-/2 LINE
		MOVLW		0X0C	;-\ON SHOW
		CALL		LCD_IR	;-/DISPLAY
		MOVLW		0X06	;-\MODE OF INCREMENT
		CALL		LCD_IR	;-/THE INSYTE COUNTER
		RETURN
;**********************************************************************
CLEAR_LCD:
;USES W_REG_1 FOR FORMIRATE DELAY TO WHILE CYCLE
		BCF			STATUS,		RP0		;-\SET
		BCF			STATUS,		RP1		;-/BANCK 0
		MOVLW		B'10000000'			;=> MOV DATA OF IR-REGISTER TO ACCUMUKATOR
		CALL		LCD_IR				;SET POSICION ON 0 SEGMENT ON 1 LINE
		MOVLW		0X14				;-\FOR WHILE
		MOVWF		W_REG_1				;-/CYCLE
CLR_LCD1:
		MOVLW		0X20				;=> MOV DATA OF DR-REGISTER TO ACCUMUKATOR
		CALL		LCD_DR				;OUT CHAR " "
		DECFSZ		W_REG_1,	F		;-\THIS
		GOTO		CLR_LCD1			;-/WHILE
		MOVLW		B'11000000'			;=> MOV DATA OF IR-REGISTER TO ACCUMUKATOR
		CALL		LCD_IR				;SET POSICION ON 0 SEGMENT ON 2 LINE
		MOVLW		0X14				;-\FOR WHILE
		MOVWF		W_REG_1				;-/CYCLE
CLR_LCD2:
		MOVLW		0X20				;=> MOV DATA OF DR-REGISTER TO ACCUMUKATOR
		CALL		LCD_DR				;OUT CHAR " "
		DECFSZ		W_REG_1,	F		;-\THIS
		GOTO		CLR_LCD2			;-/WHILE
		RETURN
;**********************************************************************
SHOW_MODE:
		MOVLW	B'10000000'	;-\SET POSITION TO
		CALL	LCD_IR		;-/1 LINE AND 0 SEGMENT
		MOVLW	0X20		;-\OUT CHAR
		CALL	LCD_DR		;-/''
		MOVLW	0X20		;-\OUT CHAR
		CALL	LCD_DR		;-/''
		MOVLW	0X4D		;-\OUT CHAR
		CALL	LCD_DR		;-/M
		MOVLW	0X4F		;-\OUT CHAR
		CALL	LCD_DR		;-/O
		MOVLW	0X44		;-\OUT CHAR
		CALL	LCD_DR		;-/D
		MOVLW	0X45		;-\OUT CHAR
		CALL	LCD_DR		;-/E
		MOVLW	0X3A		;-\OUT CHAR
		CALL	LCD_DR		;-/:
		BTFSC	STATUS_HIGH,0X07
		GOTO	SHOW_D
		MOVLW	0X54		;-\OUT CHAR
		CALL	LCD_DR		;-/T
		GOTO	END_SHOW_MODE
SHOW_D:
		MOVLW	0X44		;-\OUT CHAR
		CALL	LCD_DR		;-/D
END_SHOW_MODE:
		MOVLW	0X20		;-\OUT CHAR
		CALL	LCD_DR		;-/''
		RETURN
;**********************************************************************
SHOW_FD_LAMP:
		BTFSC	STATUS_LOW,	0X00
		GOTO	SHOW_IL
		MOVLW	0X44		;-\OUT CHAR
		CALL	LCD_DR		;-/D
		MOVLW	0X41		;-\OUT CHAR
		CALL	LCD_DR		;-/A
		MOVLW	0X4C		;-\OUT CHAR
		CALL	LCD_DR		;-/L
		GOTO	SHOW_FD
SHOW_IL:
		MOVLW	0X20		;-\OUT CHAR
		CALL	LCD_DR		;-/''
		MOVLW	0X49		;-\OUT CHAR
		CALL	LCD_DR		;-/I
		MOVLW	0X4C		;-\OUT CHAR
		CALL	LCD_DR		;-/L
SHOW_FD:
		MOVLW	0X2D		;-\OUT CHAR
		CALL	LCD_DR		;-/-
		BTFSC	STATUS_HIGH,0X05
		GOTO	SHOW_RED
		MOVLW	0X56		;-\OUT CHAR
		CALL	LCD_DR		;-/V
		GOTO	END_SHOW_FD_LAMP
SHOW_RED
		MOVLW	0X52		;-\OUT CHAR
		CALL	LCD_DR		;-/R
END_SHOW_FD_LAMP:
		MOVLW	0X20		;-\OUT CHAR
		CALL	LCD_DR		;-/''
		RETURN
;**********************************************************************
SHOW_CAR:
		MOVLW	0X23		;-\OUT CHAR
		CALL	LCD_DR		;-/#
		BTFSC	STATUS_HIGH,0X00
		GOTO	SHOW_CAR_1
		BTFSC	STATUS_HIGH,0X01
		GOTO	SHOW_CAR_2
		BTFSC	STATUS_HIGH,0X02
		GOTO	SHOW_CAR_3
		BTFSC	STATUS_HIGH,0X03
		GOTO	SHOW_CAR_4
		RETURN
SHOW_CAR_1:
		MOVLW	0X31		;-\OUT CHAR
		CALL	LCD_DR		;-/1
		RETURN
SHOW_CAR_2:
		MOVLW	0X32		;-\OUT CHAR
		CALL	LCD_DR		;-/2
		RETURN
SHOW_CAR_3:
		MOVLW	0X33		;-\OUT CHAR
		CALL	LCD_DR		;-/3
		RETURN
SHOW_CAR_4:
		MOVLW	0X34		;-\OUT CHAR
		CALL	LCD_DR		;-/4
		RETURN
;**********************************************************************
SHOW_WAVE:
		MOVLW	B'11000000'	;-\SET POSITION TO
		CALL	LCD_IR		;-/2 LINE AND 0 SEGMENT
		MOVLW	0X57		;-\OUT CHAR
		CALL	LCD_DR		;-/W
		MOVLW	0X41		;-\OUT CHAR
		CALL	LCD_DR		;-/A
		MOVLW	0X56		;-\OUT CHAR
		CALL	LCD_DR		;-/V
		MOVLW	0X45		;-\OUT CHAR
		CALL	LCD_DR		;-/E
		MOVLW	0X3D		;-\OUT CHAR
		CALL	LCD_DR		;-/=
		MOVF	ADC_HIGH,W
		MOVWF	W_H
		MOVF	ADC_LOW,W
		MOVWF	W_L
		CALL	START_OUT_DATA
		MOVLW	0X6E		;-\OUT CHAR
		CALL	LCD_DR		;-/n
		MOVLW	0X6D		;-\OUT CHAR
		CALL	LCD_DR		;-/m
		RETURN
;**********************************************************************
SHOW_DATA:
		MOVLW	B'11001010'	;-\SET POSITION TO
		CALL	LCD_IR		;-/2 LINE AND 10 SEGMENT
		MOVLW	0X20		;-\OUT CHAR
		CALL	LCD_DR		;-/''
		BTFSC	STATUS_LOW,0X04
		GOTO	BIT_IS_SET
		BTFSC	STATUS_LOW,0X03
		GOTO	OUT_I
		GOTO	OUT_i
BIT_IS_SET:
		BTFSC	STATUS_LOW,0X03
		GOTO	OUT_T
		GOTO	OUT_D
OUT_i:
		MOVLW	0X69		;-\OUT CHAR
		CALL	LCD_DR		;-/i
		GOTO	OUT_DATA
OUT_I:
		MOVLW	0X49		;-\OUT CHAR
		CALL	LCD_DR		;-/I
		GOTO	OUT_DATA
OUT_D:
;**********************************
		MOVLW	0X44		;-\OUT CHAR
		CALL	LCD_DR		;-/D
		MOVLW	0X3D		;-\OUT CHAR
		CALL	LCD_DR		;-/=
		MOVF	RES_CEL_LG,	W	;-\
		MOVWF	TMP_CEL_LG		; |
		MOVWF	DELIMOE_H		; |
		MOVF	RES_DROB_LG_H,W	; |-\COPY RESULT THE LOGARITNM
		MOVWF	TMP_DROB_LG_H	; | |TO TEMPER REGISTERS
		MOVWF	DELIMOE_M		; |-/AND ZAGR TO DELIMOE
		MOVF	RES_DROB_LG_L,W	; |
		MOVWF	TMP_DROB_LG_L	; |
		MOVWF	DELIMOE_L		;-/
		MOVLW	0X01			;-\
		MOVWF	DELITEL_H		; |
		MOVLW	0X86			; |-\ DELITEL == D'100 000'
		MOVWF	DELITEL_M		; |-/
		MOVLW	0XA0			; |
		MOVWF	DELITEL_L		;-/
		CALL	DIV_24			; OPREDELENIE CELOJ CHASTI
		MOVF	RESULT_L,W		;-\
		MOVWF	COUNT_LCD		; |OUT CEL CHASTI
		CALL	OUT_COUNT_LCD	;-/
		MOVLW	0X2C		;-\OUT CHAR
		CALL	LCD_DR		;-/,
		MOVF	RES_DROB_0,W	;-\
		MOVWF	COUNT_LCD		; |OUT DROB CHASTI
		CALL	OUT_COUNT_LCD	;-/
		MOVF	RES_DROB_1,W	;-\
		MOVWF	COUNT_LCD		; |OUT DROB CHASTI
		CALL	OUT_COUNT_LCD	;-/
		MOVF	RES_DROB_2,W	;-\
		MOVWF	COUNT_LCD		; |OUT DROB CHASTI
		CALL	OUT_COUNT_LCD	;-/
		MOVLW	0X20		;-\OUT CHAR
		CALL	LCD_DR		;-/''
		MOVLW	0X20		;-\OUT CHAR
		CALL	LCD_DR		;-/''
		RETURN
;**********************************
OUT_T:
		MOVLW	0X54		;-\OUT CHAR
		CALL	LCD_DR		;-/T
		MOVLW	0X3D		;-\OUT CHAR
		CALL	LCD_DR		;-/=
		MOVLW	0X01		;-\
		SUBWF	RESULT_L,W	; |-\IF RESULT == 1 THEN
		BTFSC	STATUS,	Z	; |-/OUT 100%
		GOTO	SHOW_100	;-/
		CLRF	W_H
		MOVF	RES_DROB_0,W
		MOVWF	W_L
		CALL	START_OUT_DATA
		CLRF	W_H
		MOVF	RES_DROB_1,W
		MOVWF	W_L
		CALL	START_OUT_DATA
		MOVLW	0X2C		;-\OUT CHAR
		CALL	LCD_DR		;-/,
		CLRF	W_H
		MOVF	RES_DROB_2,W
		MOVWF	W_L
		CALL	START_OUT_DATA
		CLRF	W_H
		MOVF	RES_DROB_3,W
		MOVWF	W_L
		CALL	START_OUT_DATA
		MOVLW	0X25		;-\OUT CHAR
		CALL	LCD_DR		;-/%
		MOVLW	0X20		;-\OUT CHAR
		CALL	LCD_DR		;-/''
		RETURN
SHOW_100:
		MOVLW	0X31		;-\OUT CHAR
		CALL	LCD_DR		;-/1
		MOVLW	0X30		;-\OUT CHAR
		CALL	LCD_DR		;-/0
		MOVLW	0X30		;-\OUT CHAR
		CALL	LCD_DR		;-/0
		MOVLW	0X25		;-\OUT CHAR
		CALL	LCD_DR		;-/%
		MOVLW	0X20		;-\OUT CHAR
		CALL	LCD_DR		;-/''
		MOVLW	0X20		;-\OUT CHAR
		CALL	LCD_DR		;-/''
		MOVLW	0X20		;-\OUT CHAR
		CALL	LCD_DR		;-/''
		RETURN
OUT_DATA:
		MOVLW	0X3D		;-\OUT CHAR
		CALL	LCD_DR		;-/=
;**********************************
		MOVF	ADC_HIGH,W
		MOVWF	W_H
		MOVF	ADC_LOW,W
		MOVWF	W_L
		CALL	START_OUT_DATA
		MOVLW	0X20		;-\OUT CHAR
		CALL	LCD_DR		;-/''
		MOVLW	0X20		;-\OUT CHAR
		CALL	LCD_DR		;-/''
		MOVLW	0X20		;-\OUT CHAR
		CALL	LCD_DR		;-/''
		MOVLW	0X20		;-\OUT CHAR
		CALL	LCD_DR		;-/''
		MOVLW	0X20		;-\OUT CHAR
		CALL	LCD_DR		;-/''
		RETURN
;**********************************************************************
