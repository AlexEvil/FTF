;**********************************************************************
;DRDY			EQU		0X00	;-\
;SCLK			EQU		0X01	; |
;RESET			EQU		0X02	; |=>FOR ADC (DIN AND DOUT TO ADC LINE)
;OUT_ADC		EQU		0X03	; |
;IN_ADC			EQU		0X04	;-/
;**********************************************************************
RESET_ADC:
		BSF		PORTD,	RESET
		NOP
		NOP
		NOP
		NOP
		BCF		PORTD,	RESET
		NOP
		NOP
		NOP
		NOP
		BSF		PORTD,	RESET
		RETURN
;**********************************************************************
STROB_ADC:
		BCF		PORTD,	SCLK	;-\
		NOP						; |
		NOP						;-|
		NOP						;-|     _
		NOP						;-|-\ _|   EQUAL 400ns(LOW)
		BSF		PORTD,	SCLK	; |-/       AND 400ns(HIGH)
		NOP						;-|
		NOP						;-|
		NOP						;-/
		RETURN
;**********************************************************************
WRITE_ADC:
;WRITE D_IN_ADC IN ADC
;SPED = 1MHz
;USES W_REG_2
		CLRF	W_REG_2				;CLEAR TEMP REGISTER
START_WRITE:
		MOVLW	0X08
		SUBWF	W_REG_2,W
		BTFSC	STATUS,	Z
		RETURN
		BCF		STATUS,	C
		RLF		ADC_LOW,F
		BTFSC	STATUS,	C
		GOTO	BIT_D_IN_ADC_1
		BCF		PORTD,	IN_ADC
		GOTO	START_STROB
BIT_D_IN_ADC_1:
		BSF		PORTD,	IN_ADC
START_STROB:
		CALL	STROB_ADC
		INCF	W_REG_2,F		;W_REG_2 = W_REG_2 + 1
		GOTO	START_WRITE
;**********************************************************************
READ_ADC:
;USES W_REG_2
		CLRF	ADC_HIGH
		CLRF	ADC_LOW
		CLRF	W_REG_2			;CLEAR TEMP REGISTER
START_READ:
		MOVLW	0X10
		SUBWF	W_REG_2,W
		BTFSC	STATUS,	Z
		RETURN
		CALL	STROB_ADC
		BTFSC	PORTD,	OUT_ADC
		GOTO	BIT_FROM_ADC_1
		BCF		STATUS,		C
		GOTO	START_SHIFT
BIT_FROM_ADC_1:
		BSF		STATUS,		C
START_SHIFT:
		RLF		ADC_LOW,	F
		RLF		ADC_HIGH,	F
		INCF	W_REG_2,	F	;W_REG_2 = W_REG_2 + 1
		GOTO	START_READ
;**********************************************************************
SETING_CHANNEL_1:
		CALL	RESET_ADC			;-RESET ADC - AD7705BR
		MOVLW	B'00100000'			;-\WRITE TO COMMUNICATION REGISTER
		MOVWF	ADC_LOW				; |WHAT NEXT OPERATION TO BE WRITE
		CALL	WRITE_ADC			;-/TO CLOCK REGISTER
		MOVLW	B'00000101'			;-\WRITE TO CLOCK
		MOVWF	ADC_LOW				; |REGISTER
		CALL	WRITE_ADC			;-/
		MOVLW	B'00010000'			;-\WRITE TO COMMUNICATION REGISTER
		MOVWF	ADC_LOW				; |WHAT NEXT OPERATION TO BE WRITE
		CALL	WRITE_ADC			;-/TO SETUP REGISTER
		MOVLW	B'01000100'			;-\WRITE TO SETUP
		MOVWF	ADC_LOW				; |REGISTER
		CALL	WRITE_ADC			;-/
		RETURN
;**********************************************************************
SETING_CHANNEL_2:
		CALL	RESET_ADC			;-RESET ADC - AD7705BR
		MOVLW	B'00100001'			;-\WRITE TO COMMUNICATION REGISTER
		MOVWF	ADC_LOW				; |WHAT NEXT OPERATION TO BE WRITE
		CALL	WRITE_ADC			;-/TO CLOCK REGISTER
		MOVLW	B'00000101'			;-\WRITE TO CLOCK
		MOVWF	ADC_LOW				; |REGISTER
		CALL	WRITE_ADC			;-/
		MOVLW	B'00010001'			;-\WRITE TO COMMUNICATION REGISTER
		MOVWF	ADC_LOW				; |WHAT NEXT OPERATION TO BE WRITE
		CALL	WRITE_ADC			;-/TO SETUP REGISTER
		MOVLW	B'01000100'			;-\WRITE TO SETUP
		MOVWF	ADC_LOW				; |REGISTER
		CALL	WRITE_ADC			;-/
		RETURN
;**********************************************************************
READ_DATA:
		CALL	SETING_CHANNEL_1
		BTFSC	PORTD,	DRDY		;-\WAIT WHILE ADC SET LINE
		GOTO	$-0X01				;-/DRDY IN LOW STATE
		MOVLW	B'00111000'			;-\WRITE TO COMMUNICATION REGISTER
		MOVWF	ADC_LOW				; |WHAT NEXT OPERATION TO BE READ
		CALL	WRITE_ADC			;-/FROM DATA REGISTER
		CALL	READ_ADC
		RETURN
;**********************************************************************
READ_WAVE:
;FOR READING DATA OF LENGHT WAVE USES CHANEL TWO
		CALL	SETING_CHANNEL_2
		BTFSC	PORTD,	DRDY		;-\WAIT WHILE ADC SET LINE
		GOTO	$-0X01				;-/DRDY IN LOW STATE
		MOVLW	B'00111000'			;-\WRITE TO COMMUNICATION REGISTER
		MOVWF	ADC_LOW				; |WHAT NEXT OPERATION TO BE READ
		CALL	WRITE_ADC			;-/FROM DATA REGISTER
		CALL	READ_ADC
;ПРИВЕДЕНИЯ ДАННЫХ ДЛИНЫ ВОЛНЫ К СООТВЕТСТВУЮЩЕМУ ФОРМАТУ!!!!
		CLRF	DELITEL_H			;-\
		CLRF	DELITEL_M			; |CLEARING NO USES REGISTER
		CLRF	DELIMOE_H			;-/
		MOVF	ADC_HIGH,W			;-\
		MOVWF	DELIMOE_M			; |-\PREPARATION FOR SUBPROGRAMMS
		MOVF	ADC_LOW,W			; |-/OF DIVIDE
		MOVWF	DELIMOE_L			;-/
		MOVLW	0X50				;- DIV DATA FROM ADC ON D'80'
		MOVWF	DELITEL_L			;
		CALL	DIV_24				;
		MOVLW	0XB4			;-\
		ADDWF	RESULT_L,F		; |-\RESULT_M,RESULT_L += D'180'
		BTFSC	STATUS,	C		; |-/
		INCF	RESULT_M,F		;-/
		MOVF	RESULT_M,	W		;-\
		MOVWF	ADC_HIGH			; |-\COPY RESULT OF DEVIDE
		MOVF	RESULT_L,	W		; |-/TO LYMDA DATA-REGISTER
		MOVWF	ADC_LOW				;-/
		RETURN
;**********************************************************************
