;**********************************************************************
DIV_24:
;ПОДПРОГРАММА ДЕЛЕНИЯ ДВУХ ТРЁХ-БАЙТНЫХ БЕЗЗНАКОВЫ ЦЕЛЫХ ЧИСЕЛ
;ДЕЛИТЕЛЬ НАХОДИТСЯ В РЕГИСТРЕ - DELITEL_M DELITEL_L
;ДЕЛИМОЕ НАХОДИТСЯ В РЕГИСТРЕ - DELIMOE_M DELIMOE_L
;В РЕЗУЛЬТАТЕ ЧАСТНОЕ НАХОДИТСЯ В РЕГИСТРЕ - RESULT_M RESULT_L
;А ДРОБНАЯ ЧАСТЬ В ЧЕТЫРЁХ РЕГИСТРАХ RES_DROB_0 RES_DROB_1 RES_DROB_2 RES_DROB_3
		CLRF	RES_DROB_0
		CLRF	RES_DROB_1
		CLRF	RES_DROB_2
		CLRF	RES_DROB_3
		CLRF	TMP_RES_H
		CLRF	TMP_RES_L
		CLRF	TIME
		MOVF	DELITEL_H,	W
		MOVWF	TMP_DEL_H
		MOVF	DELITEL_M,	W
		MOVWF	TMP_DEL_M
		MOVF	DELITEL_L,	W
		MOVWF	TMP_DEL_L
		BCF		STATUS_LOW,0X05
INIT_DEL:
		CLRF	RESULT_H
		CLRF	RESULT_M
		CLRF	RESULT_L
		CLRF	COUNT_H
		CLRF	COUNT_M
		MOVLW	0X01
		MOVWF	COUNT_L
START_DEL:
		BTFSC	DELITEL_H,	0X07
		GOTO	LOOP
		BCF		STATUS,		C
		RLF		COUNT_L,	F
		RLF		COUNT_M,	F
		RLF		COUNT_H,	F
		BCF		STATUS,		C
		RLF		DELITEL_L,	F
		RLF		DELITEL_M,	F
		RLF		DELITEL_H,	F
		GOTO	START_DEL
LOOP:
		MOVF	DELITEL_H,	W
		SUBWF	DELIMOE_H,	W
		MOVWF	TEMP_H
		MOVF	DELITEL_M,	W
		SUBWF	DELIMOE_M,	W
		MOVWF	TEMP_M
		BTFSS	STATUS,		C
		DECF	TEMP_H,		F
		MOVF	DELITEL_L,	W
		SUBWF	DELIMOE_L,	W
		MOVWF	TEMP_L
		BTFSS	STATUS,		C
		DECF	TEMP_M,		F
		MOVF	DELITEL_H,	W
		SUBWF	DELIMOE_H,	W
		BTFSS	STATUS,		C
		GOTO	SKIP
		BTFSS	STATUS,		Z
		GOTO	NEXT
		MOVF	DELITEL_M,	W
		SUBWF	DELIMOE_M,	W
		BTFSS	STATUS,		C
		GOTO	SKIP
		BTFSS	STATUS,		Z
		GOTO	NEXT
		MOVF	DELITEL_L,	W
		SUBWF	DELIMOE_L,	W
		BTFSS	STATUS,		C
		GOTO	SKIP
NEXT:
		MOVF	TEMP_L,		W
		MOVWF	DELIMOE_L
		MOVF	TEMP_M,		W
		MOVWF	DELIMOE_M
		MOVF	TEMP_H,		W
		MOVWF	DELIMOE_H
		MOVF	COUNT_L,	W
		ADDWF	RESULT_L,	F
		MOVF	COUNT_M,	W
		ADDWF	RESULT_M,	F
		MOVF	COUNT_H,	W
		ADDWF	RESULT_H,	F
SKIP:
		BCF		STATUS,		C
		RRF		DELITEL_H,	F
		RRF		DELITEL_M,	F
		RRF		DELITEL_L,	F
		BCF		STATUS,		C
		RRF		COUNT_H,	F
		RRF		COUNT_M,	F
		RRF		COUNT_L,	F
		BTFSS	STATUS,		C
		GOTO	LOOP
		BTFSS	STATUS_LOW,0X05
		GOTO	SAVE_RESULT
		INCF	TIME,		F
		MOVLW	0X01
		SUBWF	TIME,		W
		BTFSC	STATUS,		Z
		GOTO	DROB_0
		MOVLW	0X02
		SUBWF	TIME,		W
		BTFSC	STATUS,		Z
		GOTO	DROB_1
		MOVLW	0X03
		SUBWF	TIME,		W
		BTFSC	STATUS,		Z
		GOTO	DROB_2
		MOVLW	0X04
		SUBWF	TIME,		W
		BTFSC	STATUS,		Z
		GOTO	DROB_3
		GOTO	CMP_END_DROB
DROB_3:
		MOVF	RESULT_L,	W
		MOVWF	RES_DROB_3
		GOTO	CMP_END_DROB
DROB_2:
		MOVF	RESULT_L,	W
		MOVWF	RES_DROB_2
		GOTO	CMP_END_DROB
DROB_1:
		MOVF	RESULT_L,	W
		MOVWF	RES_DROB_1
		GOTO	CMP_END_DROB
DROB_0:
		MOVF	RESULT_L,	W
		MOVWF	RES_DROB_0
CMP_END_DROB:
		MOVLW	0X05
		SUBWF	TIME,		W
		BTFSC	STATUS,		Z
		GOTO	RETURN_SUB
		CALL	MULTI_D
		GOTO	INIT_DEL
RETURN_SUB:
		MOVF	TMP_RES_H,	W
		MOVWF	RESULT_M
		MOVF	TMP_RES_L,	W
		MOVWF	RESULT_L
		RETURN
SAVE_RESULT:
		MOVF	RESULT_M,	W
		MOVWF	TMP_RES_H
		MOVF	RESULT_L,	W
		MOVWF	TMP_RES_L
		BSF		STATUS_LOW,0X05
		CALL	MULTI_D
		GOTO	INIT_DEL
MULTI_D:
		BCF		STATUS,		C
		RLF		DELIMOE_L,	F
		RLF		DELIMOE_M,	F
		RLF		DELIMOE_H,	F
		MOVF	DELIMOE_L,	W
		MOVWF	TEMP_L
		MOVF	DELIMOE_M,	W
		MOVWF	TEMP_M
		MOVF	DELIMOE_H,	W
		MOVWF	TEMP_H
		BCF		STATUS,		C
		RLF		DELIMOE_L,	F
		RLF		DELIMOE_M,	F
		RLF		DELIMOE_H,	F
		BCF		STATUS,		C
		RLF		DELIMOE_L,	F
		RLF		DELIMOE_M,	F
		RLF		DELIMOE_H,	F
		MOVF	TEMP_H,		W
		ADDWF	DELIMOE_H,	F
		MOVF	TEMP_M,		W
		ADDWF	DELIMOE_M,	F
		BTFSC	STATUS,		C
		INCF	DELIMOE_H,	F
		MOVF	TEMP_L,		W
		ADDWF	DELIMOE_L,	F
		BTFSC	STATUS,		C
		INCF	DELIMOE_M,	F
		MOVF	TMP_DEL_M,	W
		MOVWF	DELITEL_M
		MOVF	TMP_DEL_L,	W
		MOVWF	DELITEL_L
		MOVF	TMP_DEL_H,	W
		MOVWF	DELITEL_H
		RETURN
;**********************************************************************
START_OUT_DATA:
		BCF		STATUS_LOW,	0X02
		CLRF	COUNT_LCD
START_A4:
		MOVLW	0X27				;-\
		SUBWF	W_H,		W		; |
		BTFSC	STATUS,		Z		; |
		GOTO	C_4					; |
		BTFSS	STATUS,		C		; |
		GOTO	A3					; |
		GOTO	S_4					; |COMPARING W_H,W_L WITH 0X2710
C_4:								; |
		MOVLW	0X10				; |
		SUBWF	W_L,		W		; |
		BTFSS	STATUS,		C		; |
		GOTO	A3					;-/
S_4:
		MOVLW	0X27				;-\
		SUBWF	W_H,		F		; |
		MOVLW	0X10				; |-\W_H,W_L = W_H,W_L - 0X2710
		SUBWF	W_L,		F		; |-/
		BTFSS	STATUS,		C		; |
		DECF	W_H,		F		;-/
		INCF	COUNT_LCD,	F		;- COUNT_LCD = COUNT_LCD + 1
		GOTO	START_A4
A3:
		MOVF	COUNT_LCD,	F
		BTFSC	STATUS,	Z
		GOTO	A3_0
		BSF		STATUS_LOW,	0X02
		CALL	OUT_COUNT_LCD
A3_0:
		CLRF	COUNT_LCD
START_A3:
		MOVLW	0X03				;-\
		SUBWF	W_H,		W		; |
		BTFSC	STATUS,		Z		; |
		GOTO	C_3					; |
		BTFSS	STATUS,		C		; |
		GOTO	A2					; |COMPARING W_H,W_L WITH 0X03E8
		GOTO	S_3					; |
C_3:									; |
		MOVLW	0XE8				; |
		SUBWF	W_L,		W		; |
		BTFSS	STATUS,		C		; |
		GOTO	A2					;-/
S_3:
		MOVLW	0X03				;-\
		SUBWF	W_H,		F		; |
		MOVLW	0XE8				; |-\W_H,W_L = W_H,W_L - 0X03E8
		SUBWF	W_L,		F		; |-/
		BTFSS	STATUS,		C		; |
		DECF	W_H,		F		;-/
		INCF	COUNT_LCD,	F		;- COUNT_LCD = COUNT_LCD + 1
		GOTO	START_A3
A2:
		BTFSC	STATUS_LOW,	0X02
		GOTO	A2_NOT_0
		MOVF	COUNT_LCD,	F
		BTFSC	STATUS,	Z
		GOTO	A2_0
A2_NOT_0:
		BSF		STATUS_LOW,	0X02
		CALL	OUT_COUNT_LCD
A2_0:
		CLRF	COUNT_LCD
START_A2:
		MOVLW	0X00				;-\
		SUBWF	W_H,		W		; |
		BTFSC	STATUS,		Z		; |
		GOTO	C_2					; |
		BTFSS	STATUS,		C		; |
		GOTO	A1					; |
		GOTO	S_2					; |COMPARING W_H,W_L WITH 0X0064
C_2:									; |
		MOVLW	0X64				; |
		SUBWF	W_L,		W		; |
		BTFSS	STATUS,		C		; |
		GOTO	A1					;-/
S_2:
		MOVLW	0X00				;-\
		SUBWF	W_H,		F		; |
		MOVLW	0X64				; |-\W_H,W_L = W_H,W_L - 0X0064
		SUBWF	W_L,		F		; |-/
		BTFSS	STATUS,		C		; |
		DECF	W_H,		F		;-/
		INCF	COUNT_LCD,	F		;- COUNT_LCD = COUNT_LCD + 1
		GOTO	START_A2
A1:
		BTFSC	STATUS_LOW,	0X02
		GOTO	A1_NOT_0
		MOVF	COUNT_LCD,	F
		BTFSC	STATUS,	Z
		GOTO	A1_0
A1_NOT_0:
		BSF		STATUS_LOW,	0X02
		CALL	OUT_COUNT_LCD
A1_0:
		CLRF	COUNT_LCD
START_A1:
		MOVLW	0X00				;-\
		SUBWF	W_H,		W		; |
		BTFSC	STATUS,		Z		; |
		GOTO	C_1					; |
		BTFSS	STATUS,		C		; |
		GOTO	A0					; |
		GOTO	S_1					; |COMPARING W_H,W_L WITH 0X000A
C_1:									; |
		MOVLW	0X0A				; |
		SUBWF	W_L,		W		; |
		BTFSS	STATUS,		C		; |
		GOTO	A0					;-/
S_1:
		MOVLW	0X00				;-\
		SUBWF	W_H,		F		; |
		MOVLW	0X0A				; |-\W_H,W_L = W_H,W_L - 0X000A
		SUBWF	W_L,		F		; |-/
		BTFSS	STATUS,		C		; |
		DECF	W_H,		F		;-/
		INCF	COUNT_LCD,	F		;- COUNT_LCD = COUNT_LCD + 1
		GOTO	START_A1
A0:
		BTFSC	STATUS_LOW,	0X02
		GOTO	A0_NOT_0
		MOVF	COUNT_LCD,	F
		BTFSC	STATUS,	Z
		GOTO	A0_0
A0_NOT_0:
		BSF		STATUS_LOW,	0X02
		CALL	OUT_COUNT_LCD
A0_0:
		MOVF	W_L,		W
		MOVWF	COUNT_LCD
		CALL	OUT_COUNT_LCD
		RETURN
;**********************************************************************
OUT_COUNT_LCD:
;ВЫВОДИТ РЕГИСТР COUNT_LCD НА ЖКИ
;СТАРТОВАЯ ПОЗИЦИЯ ОПРЕДЕЛЯЕТСЯ В ДРУГОМ МЕСТЕ
		MOVLW	0X00
		SUBWF	COUNT_LCD,	W
		BTFSC	STATUS,		Z
		GOTO	COUNT_LCD_0
		MOVLW	0X01
		SUBWF	COUNT_LCD,	W
		BTFSC	STATUS,		Z
		GOTO	COUNT_LCD_1
		MOVLW	0X02
		SUBWF	COUNT_LCD,	W
		BTFSC	STATUS,		Z
		GOTO	COUNT_LCD_2
		MOVLW	0X03
		SUBWF	COUNT_LCD,	W
		BTFSC	STATUS,		Z
		GOTO	COUNT_LCD_3
		MOVLW	0X04
		SUBWF	COUNT_LCD,	W
		BTFSC	STATUS,		Z
		GOTO	COUNT_LCD_4
		MOVLW	0X05
		SUBWF	COUNT_LCD,	W
		BTFSC	STATUS,		Z
		GOTO	COUNT_LCD_5
		MOVLW	0X06
		SUBWF	COUNT_LCD,	W
		BTFSC	STATUS,		Z
		GOTO	COUNT_LCD_6
		MOVLW	0X07
		SUBWF	COUNT_LCD,	W
		BTFSC	STATUS,		Z
		GOTO	COUNT_LCD_7
		MOVLW	0X08
		SUBWF	COUNT_LCD,	W
		BTFSC	STATUS,		Z
		GOTO	COUNT_LCD_8
		MOVLW	0X09
		SUBWF	COUNT_LCD,	W
		BTFSC	STATUS,		Z
		GOTO	COUNT_LCD_9
		RETURN
COUNT_LCD_0:
		MOVLW	0X30
		CALL	LCD_DR			;OUT CHAR 0
		RETURN
COUNT_LCD_1:
		MOVLW	0X31
		CALL	LCD_DR			;OUT CHAR 1
		RETURN
COUNT_LCD_2:
		MOVLW	0X32
		CALL	LCD_DR			;OUT CHAR 2
		RETURN
COUNT_LCD_3:
		MOVLW	0X33
		CALL	LCD_DR			;OUT CHAR 3
		RETURN
COUNT_LCD_4:
		MOVLW	0X34
		CALL	LCD_DR			;OUT CHAR 4
		RETURN
COUNT_LCD_5:
		MOVLW	0X35
		CALL	LCD_DR			;OUT CHAR 5
		RETURN
COUNT_LCD_6:
		MOVLW	0X36
		CALL	LCD_DR			;OUT CHAR 6
		RETURN
COUNT_LCD_7:
		MOVLW	0X37
		CALL	LCD_DR			;OUT CHAR 7
		RETURN
COUNT_LCD_8:
		MOVLW	0X38
		CALL	LCD_DR			;OUT CHAR 8
		RETURN
COUNT_LCD_9:
		MOVLW	0X39
		CALL	LCD_DR			;OUT CHAR 9
		RETURN
;**********************************************************************
LG:
;USES W_H,W_L AS INPUT DATA
;USES W_REG_1, W_REG_2, W_REG_3, W_REG_4
;USES TEMP
		CLRF	RES_CEL_LG
		CLRF	RES_DROB_LG_H
		CLRF	RES_DROB_LG_L
		MOVF	W_H,	W	;-\
		MOVWF	W_REG_1		; |-\COPY INPUT DATA TO
		MOVF	W_L,	W	; |-/TEMP REGISTERS
		MOVWF	W_REG_2		;-/
		MOVLW	0X80		;-\
		MOVWF	W_REG_3		; |=> W_REG_3,W_REG_4 = B'1000000000000000'
		CLRF	W_REG_4		;-/
		MOVLW	0X0F
		MOVWF	TEMP
START_FIND:
		BCF		STATUS,	C
		RLF		W_REG_2,F
		RLF		W_REG_1,F
		BTFSC	STATUS,	C
		GOTO	END_FIND
		BCF		STATUS,	C	;-\
		RRF		W_REG_3,F	; |=> RRF W_REG_3,W_REG_4
		RRF		W_REG_4,F	;-/
		DECF	TEMP,	F
		GOTO	START_FIND
END_FIND:
;TEMP == N
		INCF	TEMP,	F
START_SUM:
		DECFSZ	TEMP,	F
		GOTO	$+0X02
		GOTO	START_LG_TABLE
		MOVLW	0X75
		ADDWF	RES_DROB_LG_H,F
		BTFSC	STATUS,	C
		INCF	RES_CEL_LG,	F
		MOVLW	0X96
		ADDWF	RES_DROB_LG_L,F
		BTFSC	STATUS,	C
		INCF	RES_DROB_LG_H,F
		GOTO	START_SUM
START_LG_TABLE:
;W_REG_3,W_REG_4 == 2^N
		CLRF	DELIMOE_H	;
		MOVF	W_H,	W	;
		MOVWF	DELIMOE_M	;
		MOVF	W_L,	W	;
		MOVWF	DELIMOE_L	;
		CLRF	DELITEL_H	;W_H,W_L/2^N
		MOVF	W_REG_3,W	;
		MOVWF	DELITEL_M	;
		MOVF	W_REG_4,W	;
		MOVWF	DELITEL_L	;
		CALL	DIV_24		;=> X / 2^N

		CLRF	W_REG_1			;-\
		MOVF	RES_DROB_0,W	; |
		MOVWF	W_REG_2			; |
		BCF		STATUS,	C		; |
		RLF		W_REG_2,F		; |
		RLF		W_REG_1,F		; |
		BCF		STATUS,	C		; |
		RLF		W_REG_2,F		; |
		RLF		W_REG_1,F		; |
		MOVF	W_REG_1,W		; |
		MOVWF	W_H				; |
		MOVF	W_REG_2,W		; |
		MOVWF	W_L				; |
		BCF		STATUS,	C		; |
		RLF		W_REG_2,F		; |
		RLF		W_REG_1,F		; |
		BCF		STATUS,	C		; |
		RLF		W_REG_2,F		; |
		RLF		W_REG_1,F		; |
		BCF		STATUS,	C		; |
		RLF		W_REG_2,F		; |
		RLF		W_REG_1,F		; |
		MOVF	W_REG_1,W		; |
		ADDWF	W_H,	F		; |
		MOVF	W_REG_2,W		; |
		ADDWF	W_L,	F		; |
		BTFSC	STATUS,	C		; |
		INCF	W_H,	F		; |W_H,W_L = RES_DROB_0 * 100 + RES_DROB_1 * 10 + RES_DROB_0
		BCF		STATUS,	C		; |W_H,W_L = W_H,W_L * 2
		RLF		W_REG_2,F		; |
		RLF		W_REG_1,F		; |
		MOVF	W_REG_1,W		; |
		ADDWF	W_H,	F		; |
		MOVF	W_REG_2,W		; |
		ADDWF	W_L,	F		; |
		BTFSC	STATUS,	C		; |
		INCF	W_H,	F		; |
		CLRF	W_REG_1			; |
		MOVF	RES_DROB_1,W	; |
		MOVWF	W_REG_2			; |
		BCF		STATUS,	C		; |
		RLF		W_REG_2,F		; |
		RLF		W_REG_1,F		; |
		MOVF	W_REG_1,W		; |
		ADDWF	W_H,	F		; |
		MOVF	W_REG_2,W		; |
		ADDWF	W_L,	F		; |
		BTFSC	STATUS,	C		; |
		INCF	W_H,	F		; |
		BCF		STATUS,	C		; |
		RLF		W_REG_2,F		; |
		RLF		W_REG_1,F		; |
		BCF		STATUS,	C		; |
		RLF		W_REG_2,F		; |
		RLF		W_REG_1,F		; |
		MOVF	W_REG_1,W		; |
		ADDWF	W_H,	F		; |
		MOVF	W_REG_2,W		; |
		ADDWF	W_L,	F		; |
		BTFSC	STATUS,	C		; |
		INCF	W_H,	F		; |
		MOVF	RES_DROB_2,W	; |
		ADDWF	W_L,	F		; |
		BTFSC	STATUS,	C		; |
		INCF	W_H,	F		; |
		BCF		STATUS,	C		; |
		RLF		W_L,	F		; |
		RLF		W_H,	F		;-/
		BSF		W_H,	0X04	;-\
		BSF		W_H,	0X03	; |-\READ
		CALL	READ_TABLE		; |-/TABLE
		BCF		PCLATH,	0X03	;-/
		NOP						;-\
		MOVWF	W_REG_1			; |=> SAVE RESULT
		NOP						;-/
		INCF	W_L,	F		;-\
		BTFSC	STATUS,	Z		; |
		INCF	W_H,	F		; |=>READ NEXT BYTE THE TABLE
		CALL	READ_TABLE		; |
		BCF		PCLATH,	0X03	;-/
		NOP						;-\
		MOVWF	W_REG_2			; |=> SAVE THE RESULT
		NOP						;-/
		MOVF	W_REG_1,	W	;-\
		ADDWF	RES_DROB_LG_H,F	; |
		BTFSC	STATUS,	C		; |
		INCF	RES_CEL_LG,	F	; |-\FORMIRATE RESULT
		MOVF	W_REG_2,	W	; |-/THE LOGARITHM
		ADDWF	RES_DROB_LG_L,F	; |
		BTFSC	STATUS,	C		; |
		INCF	RES_DROB_LG_H,F	;-/
		RETURN
;**********************************************************************
READ_TABLE:
		MOVF	W_H,		W	;-\
		MOVWF	PCLATH			; |-\ЧИТАЕМ ДАННЫЕ НОТЫ
		MOVF	W_L,		W	; |-/ИЗ ТАБЛИЦЫ
		MOVWF	PCL				;-/
;**********************************************************************
COMPARING_FD_LAMP:
		BCF		STATUS_LOW,0X06	;CLEAR BIT FOR GO TO MAIN
;STATUS_LOW=> BITE '0' => LAMP
;STATUS_HIGH=> BITE '5' => FD
;STATUS_LOW=> BITE '6' => IF THIS BIT IS '1' THEN GO TO MAIN ELSE NEXT OPERATION
;ADC_HIGH
;ADC_LOW
;340 = 0X0154
;620 = 0X026C
;**********************************
;COMPARING_SENSORS:
;**********************************
;COMPARING TYPE LAMP AND TYPE FOTODIODE WITH LENGHT OF WAVE
		MOVLW		0X01				;-\
		SUBWF		ADC_HIGH,	W		; |
		BTFSC		STATUS,		Z		; |
		GOTO		CMP_LAMP			; |
		BTFSS		STATUS,		C		; |
		GOTO		CMP_DDC				; |COMPARING ADC_HIGH,ADC_LOW WITH 0X0154
		GOTO		CMP_LN				; |
CMP_LAMP:								; |
		MOVLW		0X54				; |
		SUBWF		ADC_LOW,	W		; |
		BTFSS		STATUS,		C		; |
		GOTO		CMP_DDC				;-/
;****************
CMP_LN:
		CALL		LAMP
		BTFSC		STATUS_LOW,0X00;LAMP
		GOTO		NEXT_COMP_SENSOR
;****************
		CALL		CLEAR_LCD
		CALL		MES_CHANGE_LP
WAIT_SET_LN:
		CALL		LAMP
		BTFSS		STATUS_LOW,0X00;TYPE_LAMP
		GOTO		WAIT_SET_LN
		GOTO		NEXT_COMP_SENSOR
;**********************************
CMP_DDC:
		CALL		LAMP
		BTFSS		STATUS_LOW,0X00;TYPE_LAMP
		GOTO		NEXT_COMP_SENSOR
;****************
		CALL		CLEAR_LCD
		CALL		MES_CHANGE_LP
WAIT_SET_DDC:
		CALL		LAMP
		BTFSC		STATUS_LOW,0X00;TYPE_LAMP
		GOTO		WAIT_SET_DDC
;**********************************
NEXT_COMP_SENSOR:
		MOVLW		0X02				;-\
		SUBWF		ADC_HIGH,	W		; |
		BTFSC		STATUS,		Z		; |
		GOTO		CMP_FD				; |
		BTFSS		STATUS,		C		; |
		GOTO		CMP_F				; |COMPARING ADC_HIGH,ADC_LOW WITH 0X0154
		GOTO		CMP_K				; |
CMP_FD:									; |
		MOVLW		0X6C				; |
		SUBWF		ADC_LOW,	W		; |
		BTFSS		STATUS,		C		; |
		GOTO		CMP_F				;-/
;****************
CMP_K:
		CALL		FD
		BTFSC		STATUS_HIGH,0X05;TYPE_FD	
		RETURN
;****************
		CALL		CLEAR_LCD
		CALL		MES_CHANGE_FD
		BSF			STATUS_LOW,0X06;GOTO_NULL
WAIT_SET_K:
		CALL		FD
		BTFSS		STATUS_HIGH,0X05;TYPE_FD
		GOTO		WAIT_SET_K
		RETURN
;****************
CMP_F:
		CALL		FD
		BTFSS		STATUS_HIGH,0X05;TYPE_FD	
		RETURN
;****************
		CALL		CLEAR_LCD
		CALL		MES_CHANGE_FD
		BSF			STATUS_LOW,0X06;GOTO_NULL
WAIT_SET_F:
		CALL		FD
		BTFSC		STATUS_HIGH,0X05;TYPE_FD
		GOTO		WAIT_SET_F
		RETURN
;**********************************************************************
